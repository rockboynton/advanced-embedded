/**
 * @cliArgs --board "/ti/boards/MSP_EXP432P401R" --product "simplelink_msp432p4_sdk@3.40.01.02"
 * @versions {"data":"2020090214","timestamp":"2020090214","tool":"1.6.0+1543","templates":"2020090214"}
 */

/**
 * Import the modules used in this configuration.
 */
const I2C   = scripting.addModule("/ti/drivers/I2C", {}, false);
const I2C1  = I2C.addInstance();
const PWM   = scripting.addModule("/ti/drivers/PWM", {}, false);
const PWM1  = PWM.addInstance();
const Power = scripting.addModule("/ti/drivers/Power");
const RTOS  = scripting.addModule("/ti/drivers/RTOS");

/**
 * Write custom configuration values to the imported modules.
 */
I2C1.$name              = "CONFIG_I2C_0";
I2C1.i2c.sdaPin.$assign = "boosterpack.15";

PWM1.$name                = "CONFIG_PWM_0";
PWM1.timer.pwmPin.$assign = "boosterpack.38";

Power.performanceLevel3.$name = "ti_drivers_power_PowerMSP432PerfLevels0";
Power.performanceLevel2.$name = "ti_drivers_power_PowerMSP432PerfLevels1";
Power.performanceLevel1.$name = "ti_drivers_power_PowerMSP432PerfLevels2";
Power.performanceLevel0.$name = "ti_drivers_power_PowerMSP432PerfLevels3";


/**
 * Pinmux solution for unlocked pins/peripherals. This ensures that minor changes to the automatic solver in a future
 * version of the tool will not impact the pinmux you originally saw.  These lines can be completely deleted in order to
 * re-solve from scratch.
 */
I2C1.i2c.$suggestSolution             = "EUSCI_B0";
I2C1.i2c.sclPin.$suggestSolution      = "boosterpack.14";
PWM1.timer.$suggestSolution           = "Timer_A1";
RTOS.timer0.resource.$suggestSolution = "Timer_A0";
